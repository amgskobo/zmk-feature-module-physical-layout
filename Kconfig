## Kconfig
```kconfig
config ZMK_PHYSICAL_LAYOUTS_FEATURE
    bool "Enable physical layout modules feature"

if ZMK_PHYSICAL_LAYOUTS_FEATURE

config ZMK_PHYSICAL_LAYOUTS_FEATURE_STUDIO_RPC
    bool "Enable physical layout modules custom Studio RPC"
    depends on ZMK_STUDIO

endif

config ZMK_FEATURE_MODULE_PHYSICAL_LAYOUT_LOG_LEVEL
    int "zmk-feature-module-physical-layout log level (0 off, 1 error, 2 warning, 3 info, 4 debug)"
    range 0 4
    default 3
```
